## prj.conf
```kconfig
CONFIG_STDOUT_CONSOLE=y
CONFIG_PRINTK=y
CONFIG_NANO_TIMERS=y
CONFIG_NANO_TIMEOUTS=y
CONFIG_BLUETOOTH=y
CONFIG_BLUETOOTH_LE=y
CONFIG_BLUETOOTH_DEBUG_STDOUT=y
CONFIG_BLUETOOTH_DEBUG_GATT=y
CONFIG_BLUETOOTH_SMP=y
CONFIG_BLUETOOTH_PERIPHERAL=y
CONFIG_BLUETOOTH_GATT_DYNAMIC_DB=y
CONFIG_PWM=y
CONFIG_PWM_QMSI_NUM_PORTS=3
CONFIG_PWM_DW=n
CONFIG_PWM_QMSI=y
CONFIG_ARC_INIT=n
```

## src/main.c
```c
/* main.c - Application main entry point */

/*
 * Copyright (c) 2015 Intel Corporation
 *
 * Licensed under the Apache License, Version 2.0 (the "License");
 * you may not use this file except in compliance with the License.
 * You may obtain a copy of the License at
 *
 *     http://www.apache.org/licenses/LICENSE-2.0
 *
 * Unless required by applicable law or agreed to in writing, software
 * distributed under the License is distributed on an "AS IS" BASIS,
 * WITHOUT WARRANTIES OR CONDITIONS OF ANY KIND, either express or implied.
 * See the License for the specific language governing permissions and
 * limitations under the License.
 */

#include <stdint.h>
#include <stddef.h>
#include <string.h>
#include <errno.h>
#include <misc/printk.h>
#include <misc/byteorder.h>
#include <zephyr.h>

#include <bluetooth/bluetooth.h>
#include <bluetooth/hci.h>
#include <bluetooth/conn.h>
#include <bluetooth/uuid.h>
#include <bluetooth/gatt.h>

#include "service.h"

#define DEVICE_NAME			"Arduino101"
#define DEVICE_NAME_LEN		(sizeof(DEVICE_NAME) - 1)

/*
 * Set Advertisement data. Based on the Eddystone specification:
 * https://github.com/google/eddystone/blob/master/protocol-specification.md
 * https://github.com/google/eddystone/tree/master/eddystone-url
 */
static const struct bt_data ad[] = {
	BT_DATA_BYTES(BT_DATA_UUID16_ALL, 0xaa, 0xfe),
	BT_DATA_BYTES(BT_DATA_SVC_DATA16,
		      0xaa, 0xfe, /* Eddystone UUID */
		      0x10, /* Eddystone-URL frame type */
		      0x00, /* Calibrated Tx power at 0m */
		      0x03, /* URL Scheme Prefix https://. */
					'g', 'o', 'o', '.', 'g', 'l', '/',
					'9', 'F', 'o', 'm', 'Q', 'C'),
	BT_DATA_BYTES(BT_DATA_UUID16_ALL, 0x00, 0xfc)
};

struct bt_conn *default_conn;

static const struct bt_data sd[] = {
	BT_DATA(BT_DATA_NAME_COMPLETE, DEVICE_NAME, DEVICE_NAME_LEN),
};

static void connected(struct bt_conn *conn, uint8_t err)
{
	if (err) {
		printk("Connection failed (err %u)\n", err);
	} else {
		default_conn = bt_conn_ref(conn);
		printk("Connected\n");
	}
}

static void disconnected(struct bt_conn *conn, uint8_t reason)
{
	printk("Disconnected (reason %u)\n", reason);

	if (default_conn) {
		bt_conn_unref(default_conn);
		default_conn = NULL;
	}
}

static struct bt_conn_cb conn_callbacks = {
	.connected = connected,
	.disconnected = disconnected,
};

static void bt_ready(int err)
{
	if (err) {
		printk("Bluetooth init failed (err %d)\n", err);
		return;
	}

	printk("Bluetooth initialized\n");

	service_init();

    err = bt_le_adv_start(BT_LE_ADV_CONN, ad, ARRAY_SIZE(ad),
                            sd, ARRAY_SIZE(sd));

	if (err) {
		printk("Advertising failed to start (err %d)\n", err);
		return;
	}

	printk("Advertising successfully started\n");
}

static void auth_cancel(struct bt_conn *conn)
{
	char addr[BT_ADDR_LE_STR_LEN];

	bt_addr_le_to_str(bt_conn_get_dst(conn), addr, sizeof(addr));

	printk("Pairing cancelled: %s\n", addr);
}

static struct bt_conn_auth_cb auth_cb_display = {
	.cancel = auth_cancel,
};

#ifdef CONFIG_MICROKERNEL
void mainloop(void)
#else
void main(void)
#endif
{
	int err;

	err = bt_enable(bt_ready);
	if (err) {
		printk("Bluetooth init failed (err %d)\n", err);
		return;
	}

	bt_conn_cb_register(&conn_callbacks);
	bt_conn_auth_cb_register(&auth_cb_display);

	/* Implement notification. At the moment there is no suitable way
	 * of starting delayed work so we do it here
	 */
	while (1) {
		task_sleep(sys_clock_ticks_per_sec);

		/* Battery level simulation */
		service_notify(default_conn);
	}
}
```

## src/main-test.c
```c
#include <zephyr.h>
#include <device.h>
#include <pwm.h>
#include <sys_clock.h>
#include <misc/byteorder.h>
#include <adc.h>

#if defined(CONFIG_STDOUT_CONSOLE)
#include <stdio.h>
#define PRINT           printf
#else
#include <misc/printk.h>
#define PRINT           printk
#endif

#define IO3_RED   "PWM_0"
#define IO5_GREEN "PWM_1"
#define IO6_BLUE  "PWM_2"

#define ADC_DEVICE_NAME "ADC_0"

/*
 * The analog input pin and channel number mapping
 * for Arduino 101 board.
 * A0 Channel 10
 * A1 Channel 11
 * A2 Channel 12
 * A3 Channel 13
 * A4 Channel 14
 */
#define A0 10
#define BUFFER_SIZE 40

static uint8_t buffer[BUFFER_SIZE];

static struct adc_seq_entry sample = {
	.sampling_delay = 12,
	.channel_id = A0,
	.buffer = buffer,
	.buffer_length = BUFFER_SIZE,
};

static struct adc_seq_table table = {
	.entries = &sample,
	.num_entries = 1,
};

#define SLEEPTICKS  SECONDS(1)

void main(void)
{
  struct nano_timer timer;
	uint32_t data[2] = {0, 0};

  struct device *red, *green, *blue, *tmp36;

  PRINT("Zephyr WebBluetooth demo\n");

  red = device_get_binding(IO3_RED);
  green = device_get_binding(IO5_GREEN);
  blue = device_get_binding(IO6_BLUE);

  if (!red || !green || !blue) {
    PRINT("Cannot find LED connected to pin 3 (red), 5 (green) and 6 (blue).\n");
  }

  tmp36 = device_get_binding(ADC_DEVICE_NAME);
  if (!tmp36) {
    PRINT("Cannot find the TMP36 connected to pin A0.\n");
  }

	nano_timer_init(&timer, data);
	adc_enable(tmp36);

  while (1) {
    pwm_pin_set_values(red, 1024, SLEEPTICKS, 0);

    if (adc_read(tmp36, &table) == 0) {
      uint32_t length = BUFFER_SIZE;
      uint8_t *buf = buffer;
      for (; length > 0; length -= 4, buf += 4) {
		    uint32_t rawValue = *((uint32_t *) buf);
        float voltage = (rawValue / 1024.0) * 5.0;
        float celsius = (voltage - 0.5) * 100;
        PRINT("Celsius %f\n", celsius);
	    }
    }

    nano_timer_start(&timer, SLEEPTICKS);
    nano_timer_test(&timer, TICKS_UNLIMITED);
  }

  adc_disable(tmp36);
}
```

## src/service.c
```c
/** @file
 *  @brief BAS Service sample
 */

/*
 * Copyright (c) 2016 Intel Corporation
 *
 * Licensed under the Apache License, Version 2.0 (the "License");
 * you may not use this file except in compliance with the License.
 * You may obtain a copy of the License at
 *
 *     http://www.apache.org/licenses/LICENSE-2.0
 *
 * Unless required by applicable law or agreed to in writing, software
 * distributed under the License is distributed on an "AS IS" BASIS,
 * WITHOUT WARRANTIES OR CONDITIONS OF ANY KIND, either express or implied.
 * See the License for the specific language governing permissions and
 * limitations under the License.
 */

#include <stdint.h>
#include <stddef.h>
#include <string.h>
#include <errno.h>
#include <misc/printk.h>
#include <misc/byteorder.h>
#include <zephyr.h>
#include <device.h>
#include <pwm.h>
#include <adc.h>

#include <bluetooth/bluetooth.h>
#include <bluetooth/hci.h>
#include <bluetooth/conn.h>
#include <bluetooth/uuid.h>
#include <bluetooth/gatt.h>

#define BT_UUID_WEBBT BT_UUID_DECLARE_16(0xfc00)

#define BT_UUID_TEMP BT_UUID_DECLARE_16(0xfc0a)
#define BT_UUID_RGB BT_UUID_DECLARE_16(0xfc0b)

#define SENSOR_1_NAME "Temperature"
#define SENSOR_2_NAME "Led"

static struct bt_gatt_ccc_cfg  blvl_ccc_cfg[CONFIG_BLUETOOTH_MAX_PAIRED] = {};
static uint8_t simulate_blvl;
static uint8_t temperature = 20;
static uint8_t rgb[3] = {0xff, 0x00, 0x00}; // red

struct device *pwm, *tmp36;
#define IO3_RED   0
#define IO5_GREEN 1
#define IO6_BLUE  2

#define ADC_DEVICE_NAME "ADC_0"

#define SLEEPTICKS      SECONDS(1)
/* about 2 ms, thus 500Hz */
#define PERIOD 64000
#define MAX(a,b) (((a)>(b))?(a):(b))

void pwm_write(void)
{
    uint32_t r_on, g_on, b_on;
    uint32_t r_off, g_off, b_off;

    r_on = (rgb[0] / 255.0) * PERIOD;
    g_on = (rgb[1] / 255.0) * PERIOD;
    b_on = (rgb[2] / 255.0) * PERIOD;

    r_on = MAX(1, r_on);
    g_on = MAX(1, g_on);
    b_on = MAX(1, b_on);

    r_off = PERIOD - r_on;
    g_off = PERIOD - g_on;
    b_off = PERIOD - b_on;

    r_off = MAX(1, r_off);
    g_off = MAX(1, g_off);
    b_off = MAX(1, b_off);

    printk("rgb: %x %x %x\n", rgb[0], rgb[1], rgb[2]);
    printk("on : %x %x %x\n", r_on, g_on, b_on);
    printk("off: %x %x %x\n", r_off, g_off, b_off);

    pwm_pin_set_values(pwm, IO3_RED, r_on, r_off);
    pwm_pin_set_values(pwm, IO5_GREEN, g_on, g_off);
    pwm_pin_set_values(pwm, IO6_BLUE, b_on, b_off);
}

static void blvl_ccc_cfg_changed(uint16_t value)
{
    simulate_blvl = (value == BT_GATT_CCC_NOTIFY) ? 1 : 0;
}

static ssize_t read_temperature(struct bt_conn *conn, const struct bt_gatt_attr *attr,
    void *buf, uint16_t len, uint16_t offset)
{
    const char *value = attr->user_data;

    return bt_gatt_attr_read(conn, attr, buf, len, offset, value,
        sizeof(*value));
}

static ssize_t read_rgb(struct bt_conn *conn, const struct bt_gatt_attr *attr,
    void *buf, uint16_t len, uint16_t offset)
{
    memcpy(rgb, attr->user_data, sizeof(rgb));

    printk("read_rgb: %x %x %x\n", rgb[0], rgb[1], rgb[2]);

    return bt_gatt_attr_read(conn, attr, buf, len, offset, rgb,
                 sizeof(rgb));
}

static ssize_t write_rgb(struct bt_conn *conn, const struct bt_gatt_attr *attr,
    const void *buf, uint16_t len, uint16_t offset)
{
    memcpy(rgb, buf, sizeof(rgb));

    printk("write_rgb: %x %x %x\n", rgb[0], rgb[1], rgb[2]);

    pwm_write();

    return sizeof(rgb);
}

/* WebBT Service Declaration */
static struct bt_gatt_attr attrs[] = {
    BT_GATT_PRIMARY_SERVICE(BT_UUID_WEBBT),

    /* Temperature */
    BT_GATT_CHARACTERISTIC(BT_UUID_TEMP,
        BT_GATT_CHRC_READ | BT_GATT_CHRC_NOTIFY),
    BT_GATT_DESCRIPTOR(BT_UUID_TEMP, BT_GATT_PERM_READ,
        read_temperature, NULL, &temperature),
    BT_GATT_CUD(SENSOR_1_NAME, BT_GATT_PERM_READ),
    BT_GATT_CCC(blvl_ccc_cfg, blvl_ccc_cfg_changed),

    /* RGB Led */
    BT_GATT_CHARACTERISTIC(BT_UUID_RGB,
        BT_GATT_CHRC_READ | BT_GATT_CHRC_WRITE),
    BT_GATT_DESCRIPTOR(BT_UUID_RGB, BT_GATT_PERM_READ | BT_GATT_PERM_WRITE,
        read_rgb, write_rgb, rgb),
    BT_GATT_CUD(SENSOR_2_NAME, BT_GATT_PERM_READ),
};

void service_init(void)
{
    if ((pwm = device_get_binding("PWM")) == NULL)
        printk("device_get_binding: failed for PWM\n");
    else {
        pwm_write();
        printk("PWM init OK\n");
    }

    bt_gatt_register(attrs, ARRAY_SIZE(attrs));
}

void service_notify(struct bt_conn *conn)
{
    if (!simulate_blvl) {
        return;
    }

    temperature--;
    if (!temperature) {
        /* Software eco temperature charger */
        temperature = 20;
    }

    bt_gatt_notify(conn, &attrs[2], &temperature, sizeof(temperature));
}
```

## src/service.h
```c
/** @file
 *  @brief BAS Service sample
 */

/*
 * Copyright (c) 2016 Intel Corporation
 *
 * Licensed under the Apache License, Version 2.0 (the "License");
 * you may not use this file except in compliance with the License.
 * You may obtain a copy of the License at
 *
 *     http://www.apache.org/licenses/LICENSE-2.0
 *
 * Unless required by applicable law or agreed to in writing, software
 * distributed under the License is distributed on an "AS IS" BASIS,
 * WITHOUT WARRANTIES OR CONDITIONS OF ANY KIND, either express or implied.
 * See the License for the specific language governing permissions and
 * limitations under the License.
 */

void service_init(void);
void service_notify(struct bt_conn *conn);
```
